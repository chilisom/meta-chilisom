## conf/layer.conf
```bitbake
# We have a conf and classes directory, add to BBPATH
BBPATH .= ":${LAYERDIR}"

# We have a recipes-* directories, add to BBFILES
BBFILES += "${LAYERDIR}/recipes-*/*/*.bb \
	${LAYERDIR}/recipes-*/*/*.bbappend"

BBFILE_COLLECTIONS += "chilisom"
BBFILE_PATTERN_chilisom = "^${LAYERDIR}/"
BBFILE_PRIORITY_chilisom = "10"
```

## conf/machine/chiliboard.conf
```bitbake
#@TYPE: Machine
#@NAME: GRINN Chiliboard (Chilisom based board)
#@DESCRIPTION: Machine configuration for Grinn's Chiliboard system
# - Chilisom module
# - Ethernet PHY in RMII mode
# - Power button
# - USB Host
# - Debug UART (available through micro USB connector)

require conf/machine/include/chilisom.inc

MACHINE_FEATURES += "usbgadget usbhost vfat ethernet"
MACHINE_EXTRA_RRECOMMENDS =+ "kernel-modules"

KERNEL_DEVICETREE_chiliboard = "am335x-chiliboard-nand256-ram256-lcd.dtb"
```

## conf/machine/include/chilisom-prefs.inc
```bitbake
PREFERRED_PROVIDER_jpeg = "libjpeg-turbo"
PREFERRED_PROVIDER_jpeg-native = "libjpeg-turbo-native"

# Uncomment to get latest kernel provided by meta-ti
PREFERRED_PROVIDER_virtual/kernel = "linux-ti-staging"
PREFERRED_VERSION_linux-ti-staging = "3.14%"
PREFERRED_PROVIDER_virtual/bootloader = "u-boot-ti-staging"
PREFERRED_PROVIDER_u-boot = "u-boot-ti-staging"
PREFERRED_VERSION_u-boot-ti-staging = "2014.07%"


PREFERRED_PROVIDER_virtual/egl = "libgles-omap3"
PREFERRED_PROVIDER_virtual/libgles1 = "libgles-omap3"
PREFERRED_PROVIDER_virtual/libgles2 = "libgles-omap3"

# libgles-omap3:requires libdrm (>= 2.4.59)
PREFERRED_VERSION_libdrm = "2.4.59"
```

## conf/machine/include/chilisom.inc
```bitbake
#@TYPE: Machine
#@NAME: GRINN Chilisom SoC module
#@DESCRIPTION: Machine configuration for Grinn's chilisom:
# - NAND Flash
# - DDR3 RAM
# - CPU
# - ...

require conf/machine/include/ti33x.inc
require conf/machine/include/chilisom-prefs.inc

EXTRA_IMAGEDEPENDS += "u-boot"

IMAGE_FSTYPES += "tar.bz2 jffs2"
EXTRA_IMAGECMD_jffs2 = "-lnp "

SERIAL_CONSOLE = "115200 ttyO0"

KERNEL_IMAGETYPE = "zImage"

KERNEL_DEVICETREE = "am335x-chiliboard-nand0-ram128.dtb"

MACHINE_KERNEL_PR_append ="-chili"

KERNEL_EXTRA_ARGS += "LOADADDR=${UBOOT_ENTRYPOINT}"

SPL_BINARY = "MLO"
UBOOT_SUFFIX = "img"
UBOOT_MACHINE = "chiliboard_ram128m_config"
UBOOT_ENTRYPOINT = "0x80008000"
UBOOT_LOADADDRESS = "0x80008000"

IMAGE_BOOT_FILES ?= "u-boot.${UBOOT_SUFFIX} MLO"
```

## conf/machine/lcd.conf
```bitbake
#@TYPE: Machine
#@NAME: GRINN Chiliboard with LCD sandwich (Chilisom based board)
#@DESCRIPTION: Machine configuration for Grinn's Chiliboard system
# - LCD panel (24bit color)
# - I2C I/O expander (buttons)
# - Audio codec

require conf/machine/chiliboard.conf


# Use built-in LCD by default
XSERVER += "xf86-input-tslib"
GUI_MACHINE_CLASS = "smallscreen"
MACHINE_FEATURES += "touchscreen alsa"

KERNEL_DEVICETREE_lcd = "am335x-chiliboard-nand256-ram256-lcd.dtb"
KERNEL_DEVICETREE_lcd+= "am335x-chiliboard-nand512-ram512-lcd.dtb"
```
